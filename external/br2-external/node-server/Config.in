## external/br2-external/node-server/Config.in
```kconfig
config BR2_PACKAGE_NODE_SERVER
    bool "node-server"
    default y
    select BR2_PACKAGE_MOSQUITTO
    select BR2_PACKAGE_ALSA_LIB
    help
      Node server with LuaScriptVision inference engine.
```
